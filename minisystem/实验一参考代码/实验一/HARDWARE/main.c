


#include "MSP430F5529.h"       //MSP头文件
#include "key.h"               //包含按键检测功能文件
#include "IIC.h"               //包含IIC通信功能与显示函数文件

#define CPU_F ((double)32768)
#define delay_us(x) __delay_cycles((long)(CPU_F*(double)x/1000000.0))
#define delay_ms(x) __delay_cycles((long)(CPU_F*(double)x/1000.0))

void  LCD_Show_xh(){
unsigned char xh[10000]={

0x00,0x00,0x00,0x00,0x00,0x00,0x00,0x00,0x00,0x00,0x00,0x00,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0x00,
0x00,0x00,0x00,0x00,0x00,0x00,0x00,0x00,0x00,0x00,0x00,0x00,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0x00,
0x00,0x00,0x00,0x00,0x00,0x00,0x00,0x00,0x00,0x00,0x00,0x00,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0x00,
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0x00,0x00,0x00,0x00,0x00,0x00,0x00,0x00,0x00,0x00,0x00,0x00,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0x00
  };
unsigned char   m=0,n=0;
  for(m=0;m<16;m++){
    LCD_Set_Pos(n,m);
     for(n=0;n<64;n++){
      IIC_writedata(xh[m*64+n]);
  
    }
  }

}

void  LCD_Show_title(){
unsigned char title[10000]={
0x00,0x00,0x00,0x00,0x00,0x00,0x00,0x00,0x00,0x00,0x00,0x00,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0x00,
0x00,0x00,0x00,0x00,0x00,0x00,0x00,0x00,0x00,0x00,0x00,0x80,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0x00,
0x00,0x00,0x00,0x00,0x00,0x00,0x00,0x00,0x00,0x40,0xC1,0x2F,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0x00,
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0x00,0x00,0x00,0x00,0x00,0x00,0x00,0x00,0x00,0x00,0x00,0x00,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0x00

  };
unsigned char   m=0,n=0;
  for(m=0;m<16;m++){
    LCD_Set_Pos(n,m);
     for(n=0;n<64;n++){
      IIC_writedata(title[m*64+n]);
  
    }
  }

}


void  LCD_Show_name(){
unsigned char name[10000]={

0x00,0x00,0x00,0x00,0x00,0x00,0x00,0x00,0x00,0x00,0x00,0x00,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0x00,
0x00,0x00,0x00,0x00,0x00,0x00,0x00,0x00,0x00,0x00,0x00,0x00,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0x00,
0x00,0x00,0x00,0x00,0x00,0x00,0x00,0x00,0x00,0x00,0x00,0x00,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0x00,
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0x00,0x00,0x00,0x00,0x00,0x00,0x00,0x00,0x00,0x00,0x00,0x00,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0x00
};
unsigned char   m=0,n=0;
  for(m=0;m<16;m++){
    LCD_Set_Pos(n,m);
     for(n=0;n<64;n++){
      IIC_writedata(name[m*64+n]);
    }
  }
}


  int main( void )
{

 
  enum key_type key;
  unsigned long old_num=1;
  unsigned long pre_num=1;
  
  
  WDTCTL = WDTPW+WDTHOLD;  // Stop WDT

  LCD_Init();          //显示屏初始化
  LCD_Show_xh();  //初始化在(62,32)处显示数字2020长度为5
  delay_ms(500) ;
  LCD_CLS();
  
  LCD_Show_title();
  delay_ms(500) ;
  LCD_CLS();
  
  LCD_Show_name();
  delay_ms(500) ;
  LCD_CLS();
  
  void IOInit();{   //初始化端口函数

//设置P1.1和P2.1为输入模式  
    P1DIR&=~BIT1;
    P2DIR&=~BIT1;
 //设置P1.1和P2.1使能上拉/下拉模式     
    P1REN|=BIT1;
    P2REN|=BIT1;
//设置P1.1和P2.1为上拉模式      
    P1OUT|=BIT1;
    P2OUT|=BIT1;
//设置P1.0和P4.7为输出模式
    P1DIR|=BIT0;
    P4DIR|=BIT7;
  
  }
  
  IOInit(); //初始化各种端口
  while(1)
  {
    key = KeyScan();
    if( key != NOKEY )
    {
      switch(key)
      {
        case KEYLEFT  : pre_num--;    
        case KEYRIGHT : pre_num++;
      }
    }
      if(old_num!=pre_num)
      {
        LCD_ShowNum(0,0,pre_num,5,16);
      }
      old_num=pre_num;
    }
  }


