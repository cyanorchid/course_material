
#include "MSP430F5529.h"       //MSP头文件
#include "key.h"               //包含按键检测功能文件
#include "IIC.h"               //包含IIC通信功能与显示函数文件

#define CPU_F ((double)32768)
#define delay_us(x) __delay_cycles((long)(CPU_F*(double)x/1000000.0))
#define delay_ms(x) __delay_cycles((long)(CPU_F*(double)x/1000.0))//定义延时函数

//显示校徽函数
void  LCD_Show_xh(unsigned char x,unsigned char y){
//存储取模后数组
unsigned char xh[10000]={
0x00,0x00,0x00,0x00,0x00,0x00,0x00,0x00,0x00,0x00,0x00,0x00,0x00,0x00,0x00,0x00,
0x00,0x00,0x00,0x00,0x00,0x00,0x00,0x00,0x00,0x00,0x00,0x00,0x00,0x00,0x00,0x00,
0x00,0x00,0x00,0x00,0x00,0x00,0x00,0x00,0x00,0x00,0x00,0x00,0x00,0x00,0x00,0x00,
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0x00,0x00,0x00,0x00,0x00,0x00,0x00,0x00,0x00,0x00,0x00,0x00,0x00,0x00,0x00,0x00
  };//
  unsigned char  m=0,n=0;//输出的坐标变量
 for(m=0;m<8;m++){
    LCD_Set_Pos(x,m);//选择输出点
    for(n=0;n<128;n++){
      IIC_writedata(xh[m*128+n]);//输出对应位置数据
    }
  }
}

//显示标题函数
void  LCD_Show_title(unsigned char x,unsigned char  y){
//取模后数组，包含标题信息
unsigned char title[10000]={
0x00,0x00,0x00,0x00,0x00,0x00,0x00,0x00,0x00,0x00,0x00,0x00,0x00,0x00,0x00,0x00,
0x00,0x00,0x00,0x00,0x00,0x00,0x00,0x00,0x00,0x00,0x00,0x00,0x00,0x00,0x00,0x00,
0x00,0x00,0x00,0x00,0x00,0x00,0x00,0x00,0x00,0x00,0x00,0x00,0x00,0x00,0x00,0x00,
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0x00,0x00,0x00,0x00,0x00,0x00,0x00,0x00,0x00,0x00,0x00,0x00,0x00,0x00,0x00,0x00
  };
  int m=0,n=0;
  //与展示校徽函数相同
for(m=0;m<8;m++){
    LCD_Set_Pos(x,m);
    for(n=0;n<128;n++){
      IIC_writedata(title[m*128+n]);
    }
  }
}

void  LCD_Show_name(unsigned char x,unsigned char  y){
    //取模后数组，包含姓名等信息
unsigned char name[10000]={
0x00,0x00,0x00,0x00,0x00,0x00,0x00,0x00,0x00,0x00,0x00,0x00,0x00,0x00,0x00,0x00,
0x00,0x00,0x00,0x00,0x00,0x00,0x00,0x00,0x00,0x00,0x00,0x00,0x00,0x00,0x80,0x80,
0x00,0x00,0x00,0x00,0x00,0x00,0x80,0x80,0x00,0x00,0x00,0x80,0x80,0x80,0x80,0x80,
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0x00,0x00,0x00,0x00,0x00,0x00,0x00,0x00,0x00,0x00,0x00,0x00,0x00,0x00,0x00,0x00
  };
  int m=0,n=0;
  //与展示校徽函数相同
  for(m=0;m<8;m++){
    LCD_Set_Pos(x,m);
    for(n=0;n<128;n++){
      IIC_writedata(name[m*128+n]);
    }
  }
}
  void IOInit(){   //初始化端口函数

//设置P1.1和P2.1为输入模式  
    P1DIR&=~BIT1;
    P2DIR&=~BIT1;
 //设置P1.1和P2.1使能上拉/下拉模式     
    P1REN|=BIT1;
    P2REN|=BIT1;
//设置P1.1和P2.1为上拉模式      
    P1OUT|=BIT1;
    P2OUT|=BIT1;
//设置P1.0和P4.7为输出模式
    P1DIR|=BIT0;
    P4DIR|=BIT7;
  
  }
  

  int main( void )
{
  enum key_type key;
  unsigned long pre_num=0;
  int flag=0;
  
  
  WDTCTL = WDTPW+WDTHOLD;  // Stop WDT

  LCD_Init();     
  LCD_Show_xh(0,0);//显示屏初始化
  delay_ms(500) ;
  LCD_CLS();
  
  LCD_Show_title(0,0);//显示标题
  delay_ms(500) ;
  LCD_CLS();
  
  LCD_Show_name(0,0);//显示姓名
  delay_ms(1000) ;
  LCD_CLS();
  

  IOInit(); //初始化各种端口
   LCD_Set_Pos(0,0);
 LCD_ShowNum(62,3,pre_num,5,16);//显示初始值0
  while(1)//进入循环
  {
    key = KeyScan();//扫描按键
    if( key != NOKEY )
    {
      switch(key)
      {
        case KEYLEFT : 
          delay_ms(10);
          key = KeyScan();//按键防抖
          if(key==KEYLEFT){//按下左键，减一
          if(flag==0){//非负数情况
            if(pre_num==0){
            pre_num++;
            flag=1;//如果是0，变为1，加上负号
            }
            else{pre_num--;}//不是0直接减一
          }
          
          else{
            pre_num++;//负数直接加一，负号保持
          }
          
          }
          break;//退出switch
        case KEYRIGHT :
         delay_ms(10);
         key = KeyScan();//按键防抖
         if(key==KEYRIGHT){//按下右按，加一
         if(flag==1)//负数情况
         {
          if(pre_num==1)//如果是-1
          {
            pre_num--;//变为0
            flag=0;//去掉负号
            }
            else{pre_num--;}//其他负数直接减一，负号保留
          }
         else{
            pre_num++;//非负数直接加一
          }
         }
          break; //退出switch
      }
       
    }
    if(pre_num==0){LCD_CLS();}//为零清屏，去掉负号
    if (flag==1){
          LCD_ShowChar(54,3,'-',16);//根据flag判断输出是否为负数
        }
       
    LCD_ShowNum(62,3,pre_num,5,16);//输出值
    }
  }


